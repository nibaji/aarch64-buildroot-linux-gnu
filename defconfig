## defconfig
```kconfig
BR2_aarch64=y
BR2_cortex_a75_a55=y
BR2_OPTIMIZE_3=y
BR2_SHARED_STATIC_LIBS=y
BR2_TOOLCHAIN_BUILDROOT_GLIBC=y
BR2_KERNEL_HEADERS_4_9=y
BR2_PACKAGE_GLIBC_UTILS=y
BR2_GCC_VERSION_9_X=y
BR2_EXTRA_GCC_CONFIG_OPTIONS="march=armv8.2-a+crc mcpu=kryo300 mtune=a75.a55"
BR2_TOOLCHAIN_BUILDROOT_CXX=y
BR2_TOOLCHAIN_BUILDROOT_FORTRAN=y
BR2_TOOLCHAIN_BUILDROOT_DLANG=y
BR2_GCC_ENABLE_LTO=y
BR2_GCC_ENABLE_OPENMP=y
BR2_GCC_ENABLE_GRAPHITE=y
```
